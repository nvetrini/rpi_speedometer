## tests/battery/testcase.yaml
```yaml
common:
  tags:
    - unit
    - application
    - battery
    - adc

tests:
  app.battery:
    tags:
      - battery
      - adc
    min_ram: 8
    timeout: 30
```

## tests/display/testcase.yaml
```yaml
common:
  tags:
    - unit
    - application
    - display
    - ui
    - output

tests:
  app.display:
    tags:
      - display
      - ui
      - output
    min_ram: 8
    timeout: 30
```

## tests/sd_card/testcase.yaml
```yaml
common:
  tags:
    - unit
    - application
    - sd_card
    - filesystem
    - fs
  platform_allow:
    - native_sim

tests:
  app.sd_card:
    tags:
      - sd_card
      - filesystem
      - fs
    min_ram: 8
    timeout: 30
    extra_args: EXTRA_DTC_OVERLAY_FILE=boards/native_sim.overlay
```

## tests/speed_calculator/testcase.yaml
```yaml
common:
  tags:
    - unit
    - application
    - speed_calculator
    - calculation
    - math

tests:
  app.speed_calculator:
    tags:
      - speed_calculator
      - calculation
      - math
    min_ram: 8
    timeout: 30
```

## tests/storage/testcase.yaml
```yaml
common:
  tags:
    - unit
    - application
    - storage
    - nvs
    - settings

tests:
  app.storage:
    tags:
      - storage
      - nvs
      - settings
    min_ram: 8
    timeout: 30
```

## tests/wheel_sensor/testcase.yaml
```yaml
common:
  tags:
    - unit
    - application
    - wheel_sensor
    - sensor

tests:
  app.wheel_sensor:
    tags:
      - wheel_sensor
      - sensor
    min_ram: 8
    timeout: 30
```
