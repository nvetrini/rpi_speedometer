## CMakeLists.txt
```
# SPDX-License-Identifier: Apache-2.0

cmake_minimum_required(VERSION 3.20.0)
find_package(Zephyr REQUIRED HINTS $ENV{ZEPHYR_BASE})
project(speed_calculator_test)

FILE(GLOB app_sources src/*.c)
target_sources(app PRIVATE ${app_sources})

include_directories(${CMAKE_SOURCE_DIR}/../../include
    ${CMAKE_SOURCE_DIR}/../../src)
```

## prj.conf
```kconfig
CONFIG_TEST=y
CONFIG_ZTEST=y
CONFIG_PRINTK=y
CONFIG_CONSOLE=y
```

## src/mocks_speed_calculator.c
```c
/**
 * @file mocks_speed_calculator.c
 * @brief Mock implementations for speed calculator testing
 */

#include <zephyr/kernel.h>
#include <app.h>
#include <speed_calculator.h>

// FIXME: maybe use math.h in GNU mode to provide it
#ifndef M_PI
#define M_PI 3.1415926535f
#endif

/* Mock implementation of speed_calculator_update */
void speed_calculator_update(uint32_t current_count, uint32_t last_count,
		int wheel_diameter_cm, uint32_t interval_ms,
		uint32_t *total_distance_m, float *speed_kmh)
{
    uint32_t delta = current_count - last_count;
    float circumference_m = speed_calculator_circumference_m(wheel_diameter_cm);

    /* Distance traveled this period */
    float distance_this_period_m = delta * circumference_m;

    /* Total distance */
    *total_distance_m = (uint32_t)(current_count * circumference_m);

    /* Speed: distance / time * 3.6 */
    float time_s = interval_ms / 1000.0f;
    *speed_kmh = speed_calculator_speed_kmh(distance_this_period_m, time_s);
}

/* Mock implementation of speed_calculator_circumference_m */
float speed_calculator_circumference_m(int diameter_cm)
{
    return (float)(diameter_cm * 0.01f * M_PI);
}

/* Mock implementation of speed_calculator_speed_kmh */
float speed_calculator_speed_kmh(float distance_m, float time_s)
{
    if (time_s <= 0.0f) {
        return 0.0f;
    }
    return (distance_m / time_s) * 3.6f; /* Convert m/s to km/h */
}

/* Function to reset all mocks */
void mock_reset_all(void)
{
    /* No state to reset for speed calculator mocks */
}
```

## src/test_speed_calculator.c
```c
/**
 * @file test_speed_calculator.c
 * @brief Unit tests for speed calculator functionality
 */

#include <zephyr/ztest.h>
#include <zephyr/kernel.h>
#include <math.h>
#include <app.h>
#include <speed_calculator.h>

/* Test fixtures */
static struct runtime_state test_runtime_state;

/**
 * @brief Test setup function - runs before each test
 */
static void *speed_calculator_test_setup(void)
{
    /* Reset runtime state */
    memset(&test_runtime_state, 0, sizeof(test_runtime_state));
    return NULL;
}

/**
 * @brief Test teardown function - runs after each test
 */
static void speed_calculator_test_teardown(void *fixture)
{
    ARG_UNUSED(fixture);
}

/**
 * @brief Test speed calculation with zero revolutions
 */
ZTEST(speed_calculator_test, test_speed_calculation_zero_revolutions)
{
    uint32_t current_count = 0;
    uint32_t last_count = 0;
    int wheel_diameter_cm = DEFAULT_WHEEL_DIAMETER_CM;
    uint32_t interval_ms = REPORT_INTERVAL_MS;
    
    /* Calculate speed and distance */
    speed_calculator_update(
        current_count, last_count,
        wheel_diameter_cm, interval_ms,
        &test_runtime_state.total_distance_m, &test_runtime_state.last_speed_kmh);
    
    /* Verify results */
    zassert_equal(test_runtime_state.last_speed_kmh, 0.0f,
                 "Speed should be 0 km/h with no revolutions");
    zassert_equal(test_runtime_state.total_distance_m, 0,
                 "Distance should be 0 m with no revolutions");
}

/**
 * @brief Test speed calculation with constant revolutions
 */
ZTEST(speed_calculator_test, test_speed_calculation_constant_revolutions)
{
    uint32_t current_count = 10;
    uint32_t last_count = 10;
    int wheel_diameter_cm = DEFAULT_WHEEL_DIAMETER_CM;
    uint32_t interval_ms = REPORT_INTERVAL_MS;
    
    /* Calculate speed and distance */
    speed_calculator_update(
        current_count, last_count,
        wheel_diameter_cm, interval_ms,
        &test_runtime_state.total_distance_m, &test_runtime_state.last_speed_kmh);
    
    /* Verify results */
    zassert_equal(test_runtime_state.last_speed_kmh, 0.0f,
                 "Speed should be 0 km/h with no new revolutions");
}

/**
 * @brief Test speed calculation with increasing revolutions
 */
ZTEST(speed_calculator_test, test_speed_calculation_increasing_revolutions)
{
    uint32_t current_count = 100;
    uint32_t last_count = 50;
    int wheel_diameter_cm = DEFAULT_WHEEL_DIAMETER_CM;
    uint32_t interval_ms = REPORT_INTERVAL_MS;
    
    /* Calculate speed and distance */
    speed_calculator_update(
        current_count, last_count,
        wheel_diameter_cm, interval_ms,
        &test_runtime_state.total_distance_m, &test_runtime_state.last_speed_kmh);
    
    /* Verify results - should have positive speed and distance */
    zassert_true(test_runtime_state.last_speed_kmh > 0.0f,
                "Speed should be positive with increasing revolutions");
    zassert_true(test_runtime_state.total_distance_m > 0,
                "Distance should be positive with revolutions");
}

/**
 * @brief Test speed calculation with different wheel diameters
 */
ZTEST(speed_calculator_test, test_speed_calculation_different_diameters)
{
    uint32_t current_count = 100;
    uint32_t last_count = 0;
    uint32_t interval_ms = REPORT_INTERVAL_MS;
    float speed_small, speed_large;
    uint32_t distance_small, distance_large;
    
    /* Test with small wheel diameter */
    speed_calculator_update(
        current_count, last_count,
        MIN_WHEEL_DIAMETER_CM, interval_ms,
        &distance_small, &speed_small);
    
    /* Test with large wheel diameter */
    speed_calculator_update(
        current_count, last_count,
        MAX_WHEEL_DIAMETER_CM, interval_ms,
        &distance_large, &speed_large);
    
    /* Verify that larger diameter results in higher speed and distance */
    zassert_true(speed_large > speed_small,
                "Larger wheel diameter should result in higher speed");
    zassert_true(distance_large > distance_small,
                "Larger wheel diameter should result in greater distance");
}

/**
 * @brief Test speed calculation with different intervals
 */
ZTEST(speed_calculator_test, test_speed_calculation_different_intervals)
{
    uint32_t current_count = 100;
    uint32_t last_count = 0;
    int wheel_diameter_cm = DEFAULT_WHEEL_DIAMETER_CM;
    float speed_short, speed_long;
    uint32_t distance_short, distance_long;
    
    /* Test with short interval */
    speed_calculator_update(
        current_count, last_count,
        wheel_diameter_cm, 500, /* 500ms interval */
        &distance_short, &speed_short);
    
    /* Test with long interval */
    speed_calculator_update(
        current_count, last_count,
        wheel_diameter_cm, 2000, /* 2000ms interval */
        &distance_long, &speed_long);
    
    /* Verify that longer interval results in lower speed (same revolutions over longer time) */
    zassert_true(speed_short > speed_long,
                "Shorter interval should result in higher speed");
    
    /* Distance should be the same regardless of interval (based on revolutions) */
    zassert_equal(distance_short, distance_long,
                 "Distance should be the same regardless of interval");
}

/**
 * @brief Test speed calculation accumulation over multiple updates
 */
ZTEST(speed_calculator_test, test_speed_calculation_accumulation)
{
    uint32_t current_count = 0;
    uint32_t last_count = 0;
    int wheel_diameter_cm = DEFAULT_WHEEL_DIAMETER_CM;
    uint32_t interval_ms = REPORT_INTERVAL_MS;
    uint32_t total_distance = 0;
    float last_speed = 0.0f;
    
    /* Simulate multiple updates with increasing revolutions */
    for (int i = 1; i <= 10; i++) {
        current_count = i * 10; /* 10, 20, 30, ..., 100 revolutions */
        
        speed_calculator_update(
            current_count, last_count,
            wheel_diameter_cm, interval_ms,
            &total_distance, &last_speed);
        
        last_count = current_count;
    }
    
    /* Verify results */
    zassert_true(total_distance > 0,
                "Total distance should be positive after multiple updates");
    zassert_true(last_speed >= 0.0f,
                "Last speed should be non-negative");
}

/**
 * @brief Test speed calculation with realistic values
 */
ZTEST(speed_calculator_test, test_speed_calculation_realistic_values)
{
    uint32_t current_count = 2; /* 2 revolutions */
    uint32_t last_count = 0;
    int wheel_diameter_cm = 66; /* Typical 26" wheel diameter in cm */
    uint32_t interval_ms = 1000; /* 1 second */
    
    /* Calculate speed and distance */
    speed_calculator_update(
        current_count, last_count,
        wheel_diameter_cm, interval_ms,
        &test_runtime_state.total_distance_m, &test_runtime_state.last_speed_kmh);
    
    /* Verify results are reasonable */
    zassert_true(test_runtime_state.last_speed_kmh > 0.0f,
                "Speed should be positive");
    zassert_true(test_runtime_state.last_speed_kmh < 200.0f,
                "Speed should be reasonable (< 200 km/h)");
    zassert_true(test_runtime_state.total_distance_m > 0,
                "Distance should be positive");
}

/**
 * @brief Test runtime state structure initialization
 */
ZTEST(speed_calculator_test, test_runtime_state_initialization)
{
    struct runtime_state state;
    
    /* Initialize to zero */
    memset(&state, 0, sizeof(state));
    
    /* Verify default values */
    zassert_equal(state.last_count, 0,
                 "Default last count should be 0");
    zassert_equal(state.total_distance_m, 0,
                 "Default total distance should be 0");
    zassert_equal(state.last_speed_kmh, 0.0f,
                 "Default last speed should be 0.0");
}

/**
 * @brief Test suite definition
 */
ZTEST_SUITE(speed_calculator_test, 
           NULL, 
           speed_calculator_test_setup,
           NULL,
           NULL,
           speed_calculator_test_teardown);
```
